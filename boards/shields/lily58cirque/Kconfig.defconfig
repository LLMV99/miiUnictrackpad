## boards/shields/lily58cirque/Kconfig.defconfig
```kconfig
if SHIELD_LILY58CIRQUE_LEFT

# Name must be less than 16 characters long!
config ZMK_KEYBOARD_NAME
    default "Lily58Cirque"

config ZMK_SPLIT_ROLE_CENTRAL
    default y

endif

if SHIELD_LILY58CIRQUE_LEFT || SHIELD_LILY58CIRQUE_RIGHT

config ZMK_SPLIT
    default y

config I2C
	default y

config ZMK_POINTING
    default y

endif
```

## config/west.yml
```yaml
manifest:
  remotes:
    - name: zmkfirmware
      url-base: https://github.com/zmkfirmware
    - name: petejohanson
      url-base: https://github.com/petejohanson
  projects:
    - name: zmk
      import: app/west.yml
      revision: v0.2
      remote: zmkfirmware
      revision: main
      # use this branch for right side encoder support
      # until split encoder is merged into main
      #remote: petejohanson
      #revision: stephen/split-encoder
  self:
    path: config
```
